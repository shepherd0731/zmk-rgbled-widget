## dts/bindings/behaviors/include: zero_param.yaml
```yaml
description: RGB LED layer color synchronization behavior

compatible: "zmk,behavior-rgbled-layer"

include: one_param.yaml
```

## dts/bindings/behaviors/zmk,rgbled-widget.yaml
```yaml
description: RGB LED widget indicator behavior

compatible: "zmk,behavior-rgbled-widget"

include: one_param.yaml

properties:
  indicate-battery:
    type: boolean
  indicate-connectivity:
    type: boolean
  indicate-layer:
    type: boolean
```
